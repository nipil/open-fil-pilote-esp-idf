## main/Kconfig
```kconfig
menu "Open Fil Pilote"

    config OFP_HOSTNAME
        string "Machine hostname (short)"
        default "openfilpilote"
        help
            Hostname without domain, will be used for mDNS service

    config OFP_UI_WEBSERVER_REQUIRES_AUTHENTICATION
        bool "Authentice access to UI and API"
        default "y"
        help
            You may disable authentication, for example if you have another means to filter access
            For example, you are using a reverse-proxy, a firewall... or both !
            If authentication is disabled, anyone and everyone with access can change everything.

    config OFP_UI_WEBSERVER_REQUIRES_ENCRYPTION
        bool "Use TLS/SSL to encrypt webserver connections"
        default "y"
        help
            You may disable encryption, for example if you have another means to protect your access
            For example, you are using a reverse-proxy, a firewall... or both !
            If encryption is disabled, the webserver listens on tcp port "OFP_UI_WEBSERVER_INSECURE_PORT" (see advanced configuration)

    config OFP_MDNS_INSTANCE_NAME
        string "Machine hostname (short)"
        default "Open fil-pilote"
        help
            The instance name of the mDNS service

    config OFP_LOCAL_TIMEZONE_SPEC
        string "Local timezone specification"
        default "CET-1CEST,M3.5.0,M10.5.0/3"
        help
            The default value is for Europe/Paris.
            See https://www.gnu.org/software/libc/manual/html_node/TZ-Variable.html and
            https://en.wikipedia.org/wiki/List_of_tz_database_time_zones for more information.

    config OFP_SNTP_SERVER_NAME
        string "SNTP server used for time synchronization"
        default "pool.ntp.org"
        help
            This can be either an IP or a fully-qualified domain name

    menu "Advanded options"

        config OFP_UI_WEBSERVER_INSECURE_PORT
            int "TCP port for HTTP to listen to when encryption is disabled"
            default 8080
            help
                Must be different from 80 to avoid conflicts, as Wifi Manager already uses this port

        config OFP_UI_WEBSERVER_CONTROL_PORT
            int "UDP control port for the UI HTTPD server"
            default 32000
            help
                We are running multiple HTTPD servers simultaneously (wifimanager, ofp ui and api, others...)
                We need to specify different control port for each server or these will not start
                In any case, avoid the default ESP-IDF value of 32768.

        config OFP_UI_WEBSERVER_DATA_MAX_SIZE_SINGLE_OP
            int "Defines the maximum size for a single operation on input request data"
            default 1024
            help
                In order to not overload the memory, limit the amount of data that can be processed
                in single atomic operations (e.g. form data decoding, json decoding, etc...)
                This value defines the reusable buffer size for multiple block operations (uploads)

    endmenu

endmenu
```

## sdkconfig.defaults
```kconfig
# Select FLASH size according to desired hardware (nodemcu devkit v1 30p)
CONFIG_ESPTOOLPY_FLASHSIZE_4MB=y
CONFIG_ESPTOOLPY_FLASHSIZE="4MB"

# Enable HTTPS server component 
CONFIG_ESP_HTTPS_SERVER_ENABLE=y

# Expand memory for larger headers (seen on Chrome)
CONFIG_HTTPD_MAX_REQ_HDR_LEN=1024

# Wifi Manager Configuration
CONFIG_WEBAPP_LOCATION="/wm/"
CONFIG_DEFAULT_AP_SSID="ofp-wm"
CONFIG_DEFAULT_AP_PASSWORD="openfilpilote"

# Tasks statistics (for task runtime and additional CoreID)
CONFIG_FREERTOS_GENERATE_RUN_TIME_STATS=y
CONFIG_FREERTOS_VTASKLIST_INCLUDE_COREID=y

# Enable factory reset by holding GPIO36 low on boot
CONFIG_BOOTLOADER_FACTORY_RESET=y
CONFIG_BOOTLOADER_NUM_PIN_FACTORY_RESET=36
CONFIG_BOOTLOADER_FACTORY_RESET_PIN_LOW=y
CONFIG_BOOTLOADER_OTA_DATA_ERASE=y
CONFIG_BOOTLOADER_DATA_FACTORY_RESET="nvs"

# Change partition map to enable OTA updates
CONFIG_PARTITION_TABLE_CUSTOM=y
CONFIG_PARTITION_TABLE_CUSTOM_FILENAME="partitions.csv"

# Rollback in case of OTA error during update
CONFIG_BOOTLOADER_APP_ROLLBACK_ENABLE=y
```
